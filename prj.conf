## CMakeLists.txt
```
# SPDX-License-Identifier: Apache-2.0

cmake_minimum_required(VERSION 3.20.0)

find_package(Zephyr REQUIRED HINTS $ENV{ZEPHYR_BASE})
project(gophyr)

FILE(GLOB app_sources src/*.c)
target_sources(app PRIVATE ${app_sources})
```

## sample.yaml
```
common:
  harness: net
  tags:
    - net
    - wifi
    - gopher
sample:
  description: Gopher protocol client with ASCII art image rendering
  name: Gophyr - Gopher Protocol Client
tests:
  sample.net.gophyr:
    platform_allow:
      - esp32_devkitc/esp32/procpu
      - esp32s2_saola
      - esp32c3_devkitm
      - esp32s3_devkitm/esp32s3/procpu
      - esp32c6_devkitc/esp32c6/hpcore
      - nrf7002dk/nrf5340/cpuapp
      - cc3220sf_launchxl
      - disco_l475_iot1
      - reel_board
      - siwx917_rb4338a
      - frdm_rw612
      - rd_rw612_bga
    integration_platforms:
      - esp32s3_devkitm/esp32s3/procpu
      - nrf7002dk/nrf5340/cpuapp
```

## west.yml
```
manifest:
  version: 0.7

  # This repository should be cloned to: gophyr
  remotes:
    - name: zephyrproject-rtos
      url-base: https://github.com/zephyrproject-rtos

  projects:
    - name: zephyr
      remote: zephyrproject-rtos
      revision: main
      import: true
```

## prj.conf
```kconfig
# Gophyr - Gopher Protocol Client Configuration

# Basic system configuration
CONFIG_EARLY_CONSOLE=y
CONFIG_CONSOLE=y
CONFIG_CONSOLE_SUBSYS=y
CONFIG_CONSOLE_GETCHAR=y

# Stack sizes - increased for better stability
CONFIG_MAIN_STACK_SIZE=8192
CONFIG_SHELL_STACK_SIZE=8192
CONFIG_NET_TX_STACK_SIZE=2048
CONFIG_NET_RX_STACK_SIZE=2048

# Networking configuration
CONFIG_NETWORKING=y
CONFIG_TEST_RANDOM_GENERATOR=y
CONFIG_NET_IPV4=y
CONFIG_NET_IPV6=n
CONFIG_NET_TCP=y
CONFIG_NET_UDP=y
CONFIG_NET_SOCKETS=y
CONFIG_NET_DHCPV4=y
CONFIG_DNS_RESOLVER=y

# Network buffer configuration - increased for more reliable networking
CONFIG_NET_PKT_RX_COUNT=16
CONFIG_NET_PKT_TX_COUNT=16
CONFIG_NET_BUF_RX_COUNT=32
CONFIG_NET_BUF_TX_COUNT=32
CONFIG_NET_MAX_CONTEXTS=16

# Wifi configuration
CONFIG_WIFI=y
CONFIG_NET_L2_WIFI_SHELL=y
CONFIG_NET_MGMT_EVENT_QUEUE_TIMEOUT=5000
CONFIG_NET_MGMT_EVENT_QUEUE_SIZE=16

# Shell configuration
CONFIG_NET_SHELL=y
CONFIG_SHELL_VT100_COLORS=y
CONFIG_SHELL_METAKEYS=y

# Memory management
# Default heap size for general systems
# (board-specific heap sizes in respective conf files)
CONFIG_HEAP_MEM_POOL_SIZE=65536

# Logging configuration - use these for debugging
CONFIG_LOG=y
CONFIG_LOG_DEFAULT_LEVEL=3
CONFIG_NET_LOG=y
CONFIG_INIT_STACKS=y

# Network statistics
CONFIG_NET_STATISTICS=y
CONFIG_NET_STATISTICS_PERIODIC_OUTPUT=n

# Socket and network optimization to prevent memory issues
CONFIG_NET_SOCKETS_POLL_MAX=12
CONFIG_NET_CONTEXT_SYNC_RECV=y
CONFIG_NET_BUF_POOL_USAGE=y

# TCP configuration to improve socket handling
CONFIG_NET_TCP_TIME_WAIT_DELAY=3000
CONFIG_NET_TCP_MAX_SEND_WINDOW_SIZE=8192
CONFIG_NET_TCP_RECV_QUEUE_TIMEOUT=5000
```

## boards/esp32s3_devkitm_esp32s3_procpu.conf
```kconfig
# ESP32-S3 DevKitM specific configuration for Gophyr

# SPIRAM (PSRAM) configuration for ESP32-S3
CONFIG_ESP32_USE_UNSUPPORTED_REVISION=y
CONFIG_ESP_SPIRAM=y
CONFIG_ESP_SPIRAM_SIZE=8388608
CONFIG_ESP_SPIRAM_HEAP_SIZE=4096000
CONFIG_SPIRAM_MODE_OCT=y
CONFIG_SHARED_MULTI_HEAP=y

# Increase heap size for image processing
CONFIG_HEAP_MEM_POOL_SIZE=98304

# Auto DHCP for WiFi station mode
CONFIG_ESP32_WIFI_STA_AUTO_DHCPV4=y
```

## boards/nrf7002dk_nrf5340_cpuapp.conf
```kconfig
# nRF7002DK specific configuration for Gophyr

# Enable Wi-Fi features
CONFIG_WIFI=y
CONFIG_WIFI_NRF700X=y
CONFIG_WPA_SUPP=y

# Optimize network buffer sizes for better performance
CONFIG_NET_PKT_RX_COUNT=16
CONFIG_NET_PKT_TX_COUNT=16
CONFIG_NET_BUF_RX_COUNT=64
CONFIG_NET_BUF_TX_COUNT=64

# Optimize memory usage
CONFIG_HEAP_MEM_POOL_SIZE=131072

# Enable shell commands for Wi-Fi
CONFIG_NET_L2_WIFI_SHELL=y

# Optimize networking parameters
CONFIG_NET_TCP_RETRY_COUNT=8
CONFIG_NET_TCP_INIT_RETRANSMISSION_TIMEOUT=400
```

## src/main.c
```c
/*
 * Copyright (c) 2024 Gophyr
 * SPDX-License-Identifier: Apache-2.0
 */

#include <zephyr/kernel.h>
#include <zephyr/shell/shell.h>
#include <zephyr/logging/log.h>

LOG_MODULE_REGISTER(gophyr, LOG_LEVEL_INF);

/**
 * @brief Main function for Gophyr application
 *
 * This application implements a Gopher protocol client with image rendering
 * and shell interface.
 */
int main(void)
{
    LOG_INF("Gophyr - Gopher protocol client started");
    LOG_INF("Use 'gopher help' or 'g help' for available commands");
    
    /* Shell commands are registered via SYS_INIT */
    
    return 0;
}
```

## src/gopher_client.c
```c
/*
 * Copyright (c) 2023 Gopher Client
 * SPDX-License-Identifier: Apache-2.0
 */

#include <zephyr/kernel.h>
#include <zephyr/net/socket.h>
#include <zephyr/net/dns_resolve.h>
#include <zephyr/logging/log.h>
#include <stdio.h>
#include <string.h>
#include <errno.h>
#include "gopher_client.h"

LOG_MODULE_REGISTER(gopher_client, LOG_LEVEL_ERR);

/* Initialize the Gopher client */
int gopher_client_init(struct gopher_client *client)
{
    if (client == NULL) {
        return -EINVAL;
    }

    memset(client, 0, sizeof(struct gopher_client));
    client->port = GOPHER_DEFAULT_PORT;
    client->connected = false;
    client->item_count = 0;
    client->history_pos = 0;
    client->history_count = 0;

    return 0;
}

/* Connect to a Gopher server - simplified memory safe version */
int gopher_connect(struct gopher_client *client, const char *hostname, uint16_t port)
{
    /* Critical safety check */
    if (client == NULL || hostname == NULL) {
        return -EINVAL;
    }
    
    /* Safety: completely reset client state */
    memset(client, 0, sizeof(struct gopher_client));
    
    /* Set port */
    client->port = (port == 0) ? GOPHER_DEFAULT_PORT : port;
    
    /* Store hostname with safe strncpy */
    strncpy(client->hostname, hostname, GOPHER_MAX_HOSTNAME_LEN - 1);
    client->hostname[GOPHER_MAX_HOSTNAME_LEN - 1] = '\0';
    
    /* Set connected flag */
    client->connected = true;
    
    return 0;
}

/* Send a selector string to the server and receive the response */
int gopher_send_selector(struct gopher_client *client, const char *selector, 
                         char *buffer, size_t buffer_size)
{
    int ret = 0;
    int sock = -1;
    int total_received = 0;
    struct sockaddr_in server;
    char port_str[8];
    
    /* Safety checks - fail fast */
    if (client == NULL || buffer == NULL || buffer_size == 0) {
        return -EINVAL;
    }
    
    if (!client->connected || client->hostname[0] == '\0') {
        return -ENOTCONN;
    }
    
    /* Clear buffer completely */
    memset(buffer, 0, buffer_size);
    
    /* Set up server address structure */
    memset(&server, 0, sizeof(server));
    server.sin_family = AF_INET;
    server.sin_port = htons(client->port);
    
    /* Convert port to string for getaddrinfo */
    snprintf(port_str, sizeof(port_str), "%u", client->port);
    
    /* Try hostname resolution with getaddrinfo */
    struct zsock_addrinfo hints, *result;
    memset(&hints, 0, sizeof(hints));
    hints.ai_family = AF_INET;
    hints.ai_socktype = SOCK_STREAM;
    
    /* First try direct IP address parsing */
    if (zsock_inet_pton(AF_INET, client->hostname, &server.sin_addr) != 1) {
        /* Not an IP address, try DNS resolution */
        int err = zsock_getaddrinfo(client->hostname, NULL, &hints, &result);
        if (err != 0) {
            return -EHOSTUNREACH;
        }
        
        /* Copy the resolved address */
        memcpy(&server.sin_addr, 
               &((struct sockaddr_in *)result->ai_addr)->sin_addr,
               sizeof(struct in_addr));
               
        zsock_freeaddrinfo(result);
    }
    
    /* Create socket */
    sock = zsock_socket(AF_INET, SOCK_STREAM, IPPROTO_TCP);
    if (sock < 0) {
        return -ESOCKTNOSUPPORT;
    }
    
    /* Set reasonable timeouts */
    struct timeval timeout;
    timeout.tv_sec = 5;
    timeout.tv_usec = 0;
    
    zsock_setsockopt(sock, SOL_SOCKET, SO_RCVTIMEO, &timeout, sizeof(timeout));
    zsock_setsockopt(sock, SOL_SOCKET, SO_SNDTIMEO, &timeout, sizeof(timeout));
    
    /* Connect to server */
    int err = zsock_connect(sock, (struct sockaddr *)&server, sizeof(server));
    if (err < 0) {
        zsock_close(sock);
        return -errno;  /* Return the actual error code */
    }
    
    /* Prepare request */
    char request[128];
    memset(request, 0, sizeof(request));
    
    if (selector == NULL) {
        /* Empty selector */
        strcpy(request, "\r\n");
    } else {
        /* Add selector with CRLF */
        size_t req_len = strlen(selector);
        if (req_len > sizeof(request) - 3) {
            req_len = sizeof(request) - 3;
        }
        
        memcpy(request, selector, req_len);
        request[req_len] = '\r';
        request[req_len+1] = '\n';
        request[req_len+2] = '\0';
    }
    
    /* Send request */
    err = zsock_send(sock, request, strlen(request), 0);
    if (err < 0) {
        zsock_close(sock);
        return -errno;  /* Return the actual error code */
    }
    
    /* Receive response */
    char recv_buffer[128];
    int bytes_read;
    
    /* Receive data in smaller chunks to reduce stack usage */
    int recv_attempts = 0;
    while (recv_attempts < 3) { /* Try a few times */
        memset(recv_buffer, 0, sizeof(recv_buffer));
        bytes_read = zsock_recv(sock, recv_buffer, sizeof(recv_buffer) - 1, 0);
        
        if (bytes_read < 0) {
            recv_attempts++;
            k_sleep(K_MSEC(500)); /* Wait a bit before retrying */
            continue;
        } else if (bytes_read == 0) {
            /* Connection closed by server */
            break;
        }
        
        /* Don't overflow the buffer */
        if (total_received + bytes_read >= buffer_size) {
            bytes_read = buffer_size - total_received - 1;
            if (bytes_read <= 0) {
                break;
            }
        }
        
        /* Copy data to output buffer */
        memcpy(buffer + total_received, recv_buffer, bytes_read);
        total_received += bytes_read;
        buffer[total_received] = '\0';
        
        /* Check if we've filled the buffer */
        if (total_received >= buffer_size - 1) {
            break;
        }
        
        /* If we received data, reset retry counter */
        recv_attempts = 0;
    }
    
    /* Close the socket when done */
    zsock_close(sock);
    
    /* Update history if we got data */
    if (total_received > 0) {
        /* Add to history */
        if (client->history_count < 10) {
            client->history_count++;
        }
        
        /* Move to the next position */
        client->history_pos = (client->history_pos + 1) % 10;
        
        /* Store selector */
        if (selector != NULL) {
            memset(client->history[client->history_pos], 0, GOPHER_MAX_SELECTOR_LEN);
            strncpy(client->history[client->history_pos], selector, GOPHER_MAX_SELECTOR_LEN - 1);
        } else {
            client->history[client->history_pos][0] = '\0';
        }
    }
    
    return total_received;
}

/* Basic history update function - can be used for direct history management */
int gopher_update_history(struct gopher_client *client, const char *selector)
{
    if (client == NULL) {
        return -EINVAL;
    }
    
    /* Update history */
    if (client->history_count < 10) {
        client->history_count++;
    }
    
    /* Move to next position */
    client->history_pos = (client->history_pos + 1) % 10;
    
    /* Store selector */
    memset(client->history[client->history_pos], 0, GOPHER_MAX_SELECTOR_LEN);
    if (selector != NULL) {
        strncpy(client->history[client->history_pos], selector, GOPHER_MAX_SELECTOR_LEN - 1);
    }
    
    return 0;
}

/* Parse a directory listing with improved safety */
int gopher_parse_directory(struct gopher_client *client, const char *buffer)
{
    int count = 0;
    const char *line_start;
    const char *line_end;
    const char *field_start;
    const char *field_end;
    const char *buffer_end;
    size_t buffer_len;
    
    /* Critical safety check */
    if (client == NULL || buffer == NULL) {
        return -EINVAL;
    }
    
    /* Get buffer length for bounds checking */
    buffer_len = strlen(buffer);
    if (buffer_len == 0) {
        return 0;
    }
    
    /* Calculate buffer end pointer for bounds checking */
    buffer_end = buffer + buffer_len;
    
    /* Start with clean slate */
    client->item_count = 0;
    
    /* More safety: clear all items first with memset */
    memset(client->items, 0, sizeof(client->items));
    
    /* Initialize line_start to avoid potential NULL pointer */
    line_start = buffer;
    
    /* Check if this is a text file or a directory listing */
    /* If the first character isn't a valid Gopher item type followed by a display string and a tab,
       it's probably a text file, not a directory listing */
    bool is_dir_listing = false;
    
    /* First check if buffer has at least one character */
    if (buffer_len > 0) {
        char first_char = buffer[0];
        /* Check if the first character is a valid item type according to RFC 1436 */
        if (first_char == GOPHER_TYPE_TEXT ||
            first_char == GOPHER_TYPE_DIRECTORY ||
            first_char == GOPHER_TYPE_CSO ||
            first_char == GOPHER_TYPE_ERROR ||
            first_char == GOPHER_TYPE_BINHEX ||
            first_char == GOPHER_TYPE_DOS ||
            first_char == GOPHER_TYPE_UUENCODED ||
            first_char == GOPHER_TYPE_SEARCH ||
            first_char == GOPHER_TYPE_TELNET ||
            first_char == GOPHER_TYPE_BINARY ||
            first_char == GOPHER_TYPE_REDUNDANT ||
            first_char == GOPHER_TYPE_TN3270 ||
            first_char == GOPHER_TYPE_GIF ||
            first_char == GOPHER_TYPE_IMAGE ||
            first_char == 'i') {
            /* Look for a tab character which separates fields in the first line */
            if (strchr(buffer, '\t') != NULL) {
                is_dir_listing = true;
            }
        }
    }
    
    /* If this doesn't look like a directory listing, return 0 to indicate 
       it should be treated as a text file */
    if (!is_dir_listing) {
        return 0;
    }
    
    /* Parse directory listing */
    
    /* Process each line with careful bounds checking */
    while (line_start < buffer_end && count < GOPHER_MAX_DIR_ITEMS) {
        /* Verify line_start is within bounds */
        if (line_start < buffer || line_start >= buffer_end) {
            break;
        }
        
        /* Skip empty lines or if we've reached the end */
        if (*line_start == '\0') {
            break;
        }
        
        /* Find end of line with bounds checking */
        line_end = buffer_end;  /* Default to end of buffer */
        const char *crlf = memmem(line_start, buffer_end - line_start, "\r\n", 2);
        if (crlf != NULL && crlf < buffer_end) {
            line_end = crlf;
        } else {
            /* No CRLF found, this is the last line */
            line_end = buffer_end;
            /* If we're at the end of buffer without CRLF, we can still process this line */
        }
        
        /* Check if this is the terminating period */
        if (line_start[0] == '.' && line_end == line_start + 1) {
            break;
        }
        
        /* Extra safety: check if we have at least one character in the line */
        if (line_end <= line_start) {
            /* Empty line, move to next */
            if (line_end + 2 <= buffer_end) {
                line_start = line_end + 2;
            } else {
                /* We've reached the end */
                break;
            }
            continue;
        }
        
        /* Get item type (first character) with bounds check */
        client->items[count].type = line_start[0];
        
        /* Skip type character */
        field_start = line_start + 1;
        if (field_start >= buffer_end) {
            break;  /* Unexpected end of buffer */
        }
        
        /* Get display string (first field) */
        field_end = memchr(field_start, '\t', line_end - field_start);
        if (!field_end || field_end > line_end) {
            /* For info items (type 'i'), we can tolerate missing tabs 
               This makes the client more compatible with non-standard servers */
            if (client->items[count].type == 'i') {
                /* Use the whole line as the display string */
                size_t len = line_end - field_start;
                if (len >= GOPHER_MAX_SELECTOR_LEN) {
                    len = GOPHER_MAX_SELECTOR_LEN - 1;
                }
                
                /* Safer strncpy instead of memcpy */
                memset(client->items[count].display_string, 0, GOPHER_MAX_SELECTOR_LEN);
                if (len > 0) {
                    strncpy(client->items[count].display_string, field_start, len);
                }
                client->items[count].display_string[len] = '\0';
                
                /* Use empty values for other fields */
                client->items[count].selector[0] = '\0';
                /* Make sure hostname doesn't exceed buffer */
                strncpy(client->items[count].hostname, client->hostname, GOPHER_MAX_HOSTNAME_LEN - 1);
                client->items[count].hostname[GOPHER_MAX_HOSTNAME_LEN - 1] = '\0';
                client->items[count].port = client->port;
                
                /* Increment count and move to next line */
                count++;
                if (line_end + 2 <= buffer_end) {
                    line_start = line_end + 2;
                } else {
                    /* We've reached the end */
                    break;
                }
                continue;
            } else {
                /* Invalid format for non-info items, skip this line */
                if (line_end + 2 <= buffer_end) {
                    line_start = line_end + 2;
                } else {
                    /* We've reached the end */
                    break;
                }
                continue;
            }
        }
        
        /* Copy display string */
        size_t len = field_end - field_start;
        if (len >= GOPHER_MAX_SELECTOR_LEN) {
            len = GOPHER_MAX_SELECTOR_LEN - 1;
        }
        
        /* Safer strncpy instead of memcpy */
        memset(client->items[count].display_string, 0, GOPHER_MAX_SELECTOR_LEN);
        if (len > 0) {
            strncpy(client->items[count].display_string, field_start, len);
        }
        client->items[count].display_string[len] = '\0';
        
        /* Move to selector field */
        field_start = field_end + 1;
        if (field_start >= buffer_end || field_start >= line_end) {
            /* Premature end of line, skip to next */
            if (line_end + 2 <= buffer_end) {
                line_start = line_end + 2;
            } else {
                /* We've reached the end */
                break;
            }
            continue;
        }
        
        /* Get selector (second field) */
        field_end = memchr(field_start, '\t', line_end - field_start);
        if (!field_end || field_end > line_end) {
            /* Invalid format, skip this line */
            if (line_end + 2 <= buffer_end) {
                line_start = line_end + 2;
            } else {
                /* We've reached the end */
                break;
            }
            continue;
        }
        
        /* Copy selector */
        len = field_end - field_start;
        if (len >= GOPHER_MAX_SELECTOR_LEN) {
            len = GOPHER_MAX_SELECTOR_LEN - 1;
        }
        
        /* Safer strncpy instead of memcpy */
        memset(client->items[count].selector, 0, GOPHER_MAX_SELECTOR_LEN);
        if (len > 0) {
            strncpy(client->items[count].selector, field_start, len);
        }
        client->items[count].selector[len] = '\0';
        
        /* Move to hostname field */
        field_start = field_end + 1;
        if (field_start >= buffer_end || field_start >= line_end) {
            /* Premature end of line, skip to next */
            if (line_end + 2 <= buffer_end) {
                line_start = line_end + 2;
            } else {
                /* We've reached the end */
                break;
            }
            continue;
        }
        
        /* Get hostname (third field) */
        field_end = memchr(field_start, '\t', line_end - field_start);
        if (!field_end || field_end > line_end) {
            /* Invalid format, skip this line */
            if (line_end + 2 <= buffer_end) {
                line_start = line_end + 2;
            } else {
                /* We've reached the end */
                break;
            }
            continue;
        }
        
        /* Copy hostname */
        len = field_end - field_start;
        if (len >= GOPHER_MAX_HOSTNAME_LEN) {
            len = GOPHER_MAX_HOSTNAME_LEN - 1;
        }
        
        /* Safer strncpy instead of memcpy */
        memset(client->items[count].hostname, 0, GOPHER_MAX_HOSTNAME_LEN);
        if (len > 0) {
            strncpy(client->items[count].hostname, field_start, len);
        }
        client->items[count].hostname[len] = '\0';
        
        /* Move to port field */
        field_start = field_end + 1;
        if (field_start >= buffer_end || field_start >= line_end) {
            /* Premature end of line, skip to next */
            if (line_end + 2 <= buffer_end) {
                line_start = line_end + 2;
            } else {
                /* We've reached the end */
                break;
            }
            continue;
        }
        
        /* Get port (fourth field) - safely convert to integer */
        /* First create a null-terminated temporary buffer for the port string */
        char port_str[16] = {0};
        len = MIN(line_end - field_start, sizeof(port_str) - 1);
        
        /* Extract port string with bounds checking */
        if (len > 0) {
            strncpy(port_str, field_start, len);
            port_str[len] = '\0';
            
            /* Convert to integer with error handling */
            long port_val = strtol(port_str, NULL, 10);
            if (port_val <= 0 || port_val > UINT16_MAX) {
                /* Invalid port, use default */
                client->items[count].port = GOPHER_DEFAULT_PORT;
            } else {
                client->items[count].port = (uint16_t)port_val;
            }
        } else {
            /* No port specified, use default */
            client->items[count].port = GOPHER_DEFAULT_PORT;
        }
        
        /* Check for Gopher+ attributes - we'll ignore them for now */
        
        /* Increment count and move to next line */
        count++;
        if (line_end + 2 <= buffer_end) {
            line_start = line_end + 2;
        } else {
            /* We've reached the end */
            break;
        }
    }
    
    client->item_count = count;
    /* Directory parsing complete */
    return count;
}

/* Get string representation of item type */
const char *gopher_type_to_str(char type)
{
    switch (type) {
        case GOPHER_TYPE_TEXT:
            return "Text File";
        case GOPHER_TYPE_DIRECTORY:
            return "Directory";
        case GOPHER_TYPE_CSO:
            return "CSO Phone-book Server";
        case GOPHER_TYPE_ERROR:
            return "Error";
        case GOPHER_TYPE_BINHEX:
            return "BinHexed Macintosh File";
        case GOPHER_TYPE_DOS:
            return "DOS Binary";
        case GOPHER_TYPE_UUENCODED:
            return "UNIX uuencoded File";
        case GOPHER_TYPE_SEARCH:
            return "Search Server";
        case GOPHER_TYPE_TELNET:
            return "Telnet Session";
        case GOPHER_TYPE_BINARY:
            return "Binary File";
        case GOPHER_TYPE_REDUNDANT:
            return "Redundant Server";
        case GOPHER_TYPE_TN3270:
            return "TN3270 Session";
        case GOPHER_TYPE_GIF:
            return "GIF Image (g)";
        case GOPHER_TYPE_IMAGE:
            return "Image (I)";
        case 'i':
            return "Info Line";
        default:
            return "Unknown";
    }
}
```

## src/gopher_client.h
```c
/*
 * Copyright (c) 2023 Gopher Client
 * SPDX-License-Identifier: Apache-2.0
 */

#ifndef GOPHER_CLIENT_H_
#define GOPHER_CLIENT_H_

#include <zephyr/kernel.h>

/* Maximum number of items in a directory listing */
#define GOPHER_MAX_DIR_ITEMS 64

/* Maximum length of selector strings */
#define GOPHER_MAX_SELECTOR_LEN 256

/* Maximum length of a server hostname */
#define GOPHER_MAX_HOSTNAME_LEN 64

/* Default Gopher port */
#define GOPHER_DEFAULT_PORT 70

/* Maximum buffer size for responses (increased for better image handling) */
#define GOPHER_BUFFER_SIZE 16384

/* Item type definitions per RFC 1436 */
#define GOPHER_TYPE_TEXT '0'
#define GOPHER_TYPE_DIRECTORY '1'
#define GOPHER_TYPE_CSO '2'
#define GOPHER_TYPE_ERROR '3'
#define GOPHER_TYPE_BINHEX '4'
#define GOPHER_TYPE_DOS '5'
#define GOPHER_TYPE_UUENCODED '6'
#define GOPHER_TYPE_SEARCH '7'
#define GOPHER_TYPE_TELNET '8'
#define GOPHER_TYPE_BINARY '9'
#define GOPHER_TYPE_REDUNDANT '+'
#define GOPHER_TYPE_TN3270 'T'
#define GOPHER_TYPE_GIF 'g'
#define GOPHER_TYPE_IMAGE 'I'

/* Structure to represent a Gopher item */
struct gopher_item {
    char type;
    char display_string[GOPHER_MAX_SELECTOR_LEN];
    char selector[GOPHER_MAX_SELECTOR_LEN];
    char hostname[GOPHER_MAX_HOSTNAME_LEN];
    uint16_t port;
};

/* Structure to represent the Gopher client state */
struct gopher_client {
    /* Current server information */
    char hostname[GOPHER_MAX_HOSTNAME_LEN];
    uint16_t port;
    
    /* Connection status */
    bool connected;
    
    /* Last directory listing */
    struct gopher_item items[GOPHER_MAX_DIR_ITEMS];
    int item_count;
    
    /* Navigation history */
    char history[10][GOPHER_MAX_SELECTOR_LEN];
    int history_pos;
    int history_count;
};

/**
 * @brief Initialize the Gopher client
 *
 * @param client Pointer to the client structure
 * @return 0 on success, negative errno otherwise
 */
int gopher_client_init(struct gopher_client *client);

/**
 * @brief Connect to a Gopher server
 *
 * @param client Pointer to the client structure
 * @param hostname Server hostname
 * @param port Server port (use 0 for default)
 * @return 0 on success, negative errno otherwise
 */
int gopher_connect(struct gopher_client *client, const char *hostname, uint16_t port);

/**
 * @brief Send a selector to the server and receive the response
 *
 * @param client Pointer to the client structure
 * @param selector Selector string to send
 * @param buffer Buffer to store the response
 * @param buffer_size Size of the buffer
 * @return Size of received data on success, negative errno otherwise
 */
int gopher_send_selector(struct gopher_client *client, const char *selector, 
                         char *buffer, size_t buffer_size);

/**
 * @brief [DEPRECATED] Update navigation history with a new selector
 * This function is now a stub - history management is handled directly in gopher_send_selector
 * 
 * @param client Pointer to the client structure
 * @param selector Selector string to add to history
 * @return 0 on success, negative errno otherwise
 */
int gopher_update_history(struct gopher_client *client, const char *selector);

/**
 * @brief Parse a directory listing from a buffer
 *
 * @param client Pointer to the client structure
 * @param buffer Buffer containing the directory listing
 * @return Number of items parsed on success, negative errno otherwise
 */
int gopher_parse_directory(struct gopher_client *client, const char *buffer);

/**
 * @brief Get string representation of item type
 * 
 * @param type Item type character
 * @return Pointer to string description
 */
const char *gopher_type_to_str(char type);

#endif /* GOPHER_CLIENT_H_ */
```

## src/gopher_image.h
```c
/*
 * Copyright (c) 2024 Gopher Image Viewer
 * SPDX-License-Identifier: Apache-2.0
 */

#ifndef GOPHER_IMAGE_H_
#define GOPHER_IMAGE_H_

#include <zephyr/kernel.h>
#include <zephyr/shell/shell.h>

/* Structure for RGB pixel handling */
typedef struct {
    uint8_t r, g, b;
} rgb_pixel_t;

/* Options for image processing */
typedef struct {
    bool maintain_aspect_ratio;
    bool use_bilinear_filtering;
    float brightness_adjust;  /* 0.5-2.0, 1.0 is neutral */
    float contrast_adjust;    /* 0.5-2.0, 1.0 is neutral */
} image_process_options_t;

/* Configuration struct for ASCII art rendering */
typedef struct {
    bool use_color;          /* Use color or grayscale */
    bool use_dithering;      /* Apply dithering to improve color */
    bool use_extended_chars; /* Use extended ASCII for better resolution */
    int color_mode;          /* 8 or 16 colors */
    float brightness;        /* Brightness adjustment (0.5-2.0) */
    float contrast;          /* Contrast adjustment (0.5-2.0) */
} ascii_art_config_t;

/**
 * @brief Render an image file as ASCII art on the console
 *
 * @param shell Pointer to the shell instance
 * @param file_data Pointer to the file data buffer
 * @param file_size Size of the file data buffer
 * @param config Pointer to the ASCII art configuration (or NULL for default)
 * @return 0 on success, negative errno otherwise
 */
int gopher_render_image(const struct shell *shell, uint8_t *file_data, 
                        size_t file_size, ascii_art_config_t *config);

/**
 * @brief Determine if a file might be an image based on magic numbers
 *
 * @param data Pointer to the file data buffer
 * @param size Size of the file data buffer
 * @return true if the file is likely an image, false otherwise
 */
bool gopher_is_image(const uint8_t *data, size_t size);

/**
 * @brief Initialize the image rendering module
 *
 * @return 0 on success, negative errno otherwise
 */
int gopher_image_init(void);

#endif /* GOPHER_IMAGE_H_ */
```
